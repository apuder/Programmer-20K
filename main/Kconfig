## main/Kconfig
```kconfig
choice
    prompt "Target"
    default PROGRAMMER_20K
    help
        Select the target platform...

config PROGRAMMER_20K
    bool "Programmer-20K"
config STRIPBOARD
    bool "Stripboard"
config MINI_PC
    bool "MiniPC"
endchoice
```
